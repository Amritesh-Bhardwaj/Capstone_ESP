## ESP32-CSI-Tool/active_ap/sdkconfig.defaults
```kconfig
CONFIG_ESP32_WIFI_CSI_ENABLED=y
CONFIG_ESP_CONSOLE_UART_CUSTOM=y
CONFIG_ESP_CONSOLE_UART_BAUDRATE=460800
CONFIG_ESPTOOLPY_FLASHSIZE_4MB=y
CONFIG_ESPTOOLPY_FLASHSIZE="4MB"
CONFIG_ESP_WIFI_SSID="ESP32_CSI"
CONFIG_ESP_WIFI_PASSWORD="capstone26"
CONFIG_SHOULD_COLLECT_CSI=y
CONFIG_SHOULD_COLLECT_ONLY_LLTF=y
CONFIG_SEND_CSI_TO_SERIAL=y
```

## ESP32-CSI-Tool/passive/sdkconfig.defaults
```kconfig
CONFIG_ESP32_WIFI_CSI_ENABLED=y
CONFIG_ESP_CONSOLE_UART_CUSTOM=y
CONFIG_ESP_CONSOLE_UART_BAUDRATE=460800
CONFIG_ESPTOOLPY_FLASHSIZE_4MB=y
CONFIG_ESPTOOLPY_FLASHSIZE="4MB"
```
